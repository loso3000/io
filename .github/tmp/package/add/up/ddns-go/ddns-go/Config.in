## .github/tmp/package/add/up/ddns-go/ddns-go/Config.in
```kconfig
#
# Copyright (C) 2022-2026 sirpdboy <herboy2008@gmail.com>
#
# This is free software, licensed under the Apache License, Version 2.0 .
#

menu "Configuration"
	depends on PACKAGE_ddns-go

config DDNS_GO_COMPRESS_UPX
	bool "Compress ddns-go binary with UPX"
	default y
	help
	  Compress the ddns-go binary using UPX (Ultimate Packer for Executables).
	  This will significantly reduce the package size (by 50-70%) but adds a
	  small decompression overhead when the binary is first executed.
	  
	  Benefits:
	  - Smaller package size for download and installation
	  - Saves flash space on router
	  - No performance impact after first execution
	  
	  The binary is decompressed to RAM on first run, so it still
	  runs at full speed once loaded.

config DDNS_GO_UPX_LEVEL
	string "UPX compression level"
	depends on DDNS_GO_COMPRESS_UPX
	default "--lzma --best"
	help
	  Choose the UPX compression level and options.
	  
	  Common options:
	  --lzma --best  : Maximum compression (recommended)
	  --lzma         : Good balance
	  --brute        : Slow but good compression
	  --ultra-brute  : Extreme compression (very slow build)
	  
	  Higher compression levels result in smaller binaries
	  but take longer to compress during build.

endmenu
```
